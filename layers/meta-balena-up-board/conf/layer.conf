## layers/meta-balena-up-board/conf/layer.conf
```bitbake
BBPATH .= ":${LAYERDIR}"

BBFILES += "${LAYERDIR}/recipes-*/*/*.bb \
            ${LAYERDIR}/recipes-*/*/*.bbappend"

BBFILE_COLLECTIONS += "balena-up-board"
BBFILE_PATTERN_balena-up-board := "^${LAYERDIR}/"
BBFILE_PRIORITY_balena-up-board = "1337"

LAYERSERIES_COMPAT_balena-up-board = "scarthgap"

ACPI_TABLES = " \
    pc00.spi0.spidev1.0.asl \
    pinctrl-up-ehl.asl \
    spidev1.0.asl \
    spidev1.1.asl \
    spidev2.0.asl \
    spidev2.1.asl \
    upsquared-6000-spidev1.0.asl \
    upsquared-6000-spidev1.1.asl \
    upxtreme-i11-spidev1.0.asl \
    upxtreme-i11-spidev1.1.asl \
    upxtreme-i12-spidev1.0.asl \
    upxtreme-i12-spidev1.1.asl \
    upxtreme-spidev1.0.asl \
    upxtreme-spidev1.1.asl \
"

SRCREV_machine_pn-linux-yocto_up-board = "2c5caa7e84311f2a0097974a697ac1f59030530e"

FIRMWARE_COMPRESSION ?= "1"

FULL_OPTIMIZATION = "-Os -pipe ${DEBUG_FLAGS}"

# We already add the GPU firmware for the Up Board(s) in the linux-firmware-i915-upboards package
# so let's remove the rest of unused i915 firmware and just add our custom package
MACHINE_ESSENTIAL_EXTRA_RRECOMMENDS:remove = "linux-firmware-i915"
MACHINE_ESSENTIAL_EXTRA_RRECOMMENDS:append = "linux-firmware-i915-upboards"
```

## layers/meta-resin-up-board/conf/layer.conf
```bitbake
BBPATH .= ":${LAYERDIR}"

BBFILES += "${LAYERDIR}/recipes-*/*/*.bb \
            ${LAYERDIR}/recipes-*/*/*.bbappend"

BBFILE_COLLECTIONS += "resin-up-board"
BBFILE_PATTERN_resin-up-board := "^${LAYERDIR}/"
BBFILE_PRIORITY_resin-up-board = "1337"

PREFERRED_VERSION_linux-intel ?= "4.14%"
```
